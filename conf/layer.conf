## conf/layer.conf
```bitbake
# We have a conf and classes directory, prepend to BBPATH
BBPATH .= ":${LAYERDIR}"

# We have recipes-* directories, add to BBFILES
#BBFILES += "${LAYERDIR}/recipes-*/*/*.bb ${LAYERDIR}/recipes-*/*/*.bbappend"

BBFILE_COLLECTIONS += "wr-template"
BBFILE_PATTERN_wr-template = ""
BBFILE_PATTERN_IGNORE_EMPTY_wr-template = "1"
BBFILE_PRIORITY_wr-template = "1"

# This should only be incremented on significant changes that will
# cause compatibility issues with other layers
LAYERVERSION_wr-template = "1"

LAYERDEPENDS_wr-template = "core"

# Always add the banner and core template processing
USER_CLASSES_append = " wrlbanner wrltemplate"

# Always add the image adjustment recipe
IMAGE_CLASSES_append = " wrltemplate_image"

# Exclude wrtemplate* and wrimage* from eSDK's manifest
ESDK_MANIFEST_EXCLUDES = "conf/wrtemplate* conf/wrimage*"
```

## tests/layer1/conf/layer.conf
```bitbake
# We have a conf and classes directory, add to BBPATH
BBPATH .= ":${LAYERDIR}"

# We have recipes-* directories, add to BBFILES
BBFILES += "${LAYERDIR}/recipes-*/*/*.bb"

BBFILE_COLLECTIONS += "wr-template-tests-layer1"
BBFILE_PATTERN_wr-template-tests-layer1 = "^${LAYERDIR}/"

# This should only be incremented on significant changes that will
# cause compatibility issues with other layers
LAYERVERSION_wr-template-tests-layer1 = "1"

LAYERDEPENDS_wr-template-tests-layer1 = "core wr-template"
```

## tests/layer2/conf/layer.conf
```bitbake
# We have a conf and classes directory, add to BBPATH
BBPATH .= ":${LAYERDIR}"

# We have recipes-* directories, add to BBFILES
BBFILES += "${LAYERDIR}/recipes-*/*/*.bb"

BBFILE_COLLECTIONS += "wr-template-tests-layer2"
BBFILE_PATTERN_wr-template-tests-layer2 = ""

# This should only be incremented on significant changes that will
# cause compatibility issues with other layers
LAYERVERSION_wr-template-tests-layer2 = "1"

LAYERDEPENDS_wr-template-tests-layer2 = "core wr-template wr-template-tests-layer1"
```
